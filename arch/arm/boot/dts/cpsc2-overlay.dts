/dts-v1/;
/plugin/;	/* allow undefined label references and record them */
/ {
	fragment@0 {
		target = <&i2c10>;
		__overlay__ {
			status = "okay";
		};
	};
	fragment@1 {
		target = <&i2c11>;
		__overlay__ {
			status = "okay";
		};
	};
};
