/dts-v1/;
/plugin/;	/* allow undefined label references and record them */
/ {
	fragment@1 {
		target = <&elf2_eeprom>;
		__overlay__ {
			status = "okay";
		};		
	};
	fragment@2 {
		target = <&elf2_hwmon>;
		__overlay__ {
			status = "okay";
		};		
	};	
};
