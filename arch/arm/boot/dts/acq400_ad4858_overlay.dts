// SPDX-License-Identifier: GPL-2.0
/dts-v1/;
/plugin/;	/* allow undefined label references and record them */

/ {
	fragment@0 {
		target = <&spi0>;
		__overlay__ {
			#address-cells = <1>;
			#size-cells = <0>;			
			status = "okay";

			ad485x: adc@0{
				reg = <1>;
				
				spi-max-frequency = <10000000>;
/*                
                refin-supply = <&refin>;
                clocks = <&ref_clk>;
                clock-names = "scki";
                dmas = <&rx_dma 0>;
                dma-names = "rx";
                pwms = <&axi_pwm_gen 0 0>;
                pwm-names = "cnv";
*/                
				compatible = "adi,ad4858";
			};
		};
	};
};         