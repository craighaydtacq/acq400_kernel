/dts-v1/;
/plugin/;	/* allow undefined label references and record them */
/ {
	fragment@0 {
		target = <&cpld_spi>;
		__overlay__ {
			status = "okay";
		};
	};
	
	fragment@1 {
		target = <&i2c1>;
		__overlay__ {
			status = "okay";
		};		
	};
};