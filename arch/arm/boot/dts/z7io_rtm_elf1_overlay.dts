/dts-v1/;
/plugin/;	/* allow undefined label references and record them */
/ {
	fragment@1 {
		target = <&elf1_eeprom>;
		__overlay__ {
			status = "okay";
		};		
	};
	fragment@2 {
		target = <&elf1_hwmon>;
		__overlay__ {
			status = "okay";
		};		
	};	
};
